## boards/wyres-base/Kconfig
```kconfig
config BOARD
    default "wyres-base" if BOARD_WYRES_BASE

config BOARD_WYRES_BASE
    bool
    default y
    select CPU_MODEL_STM32L151CC

    # Put defined MCU peripherals here (in alphabetical order)
    select HAS_PERIPH_ADC
    select HAS_PERIPH_DAC
    select HAS_PERIPH_DMA
    select HAS_PERIPH_I2C
    select HAS_PERIPH_PWM
    select HAS_PERIPH_RTC
    select HAS_PERIPH_SPI
    select HAS_PERIPH_SPI_GPIO_MODE
    select HAS_PERIPH_TIMER
    select HAS_PERIPH_UART

    # Put other features for this board (in alphabetical order)
    select HAS_RIOTBOOT
    
    select HAVE_SAUL_GPIO

source "$(RIOTBOARD)/common/stm32/Kconfig"
```
